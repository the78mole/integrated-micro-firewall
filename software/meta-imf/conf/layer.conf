## software/meta-imf/conf/layer.conf
```bitbake
# Layer configuration for meta-imf
BBPATH .= ":${LAYERDIR}"

# We have recipes-* directories, add to BBFILES
BBFILES += "${LAYERDIR}/recipes-*/*/*.bb \
            ${LAYERDIR}/recipes-*/*/*.bbappend"

BBFILE_COLLECTIONS += "meta-imf"
BBFILE_PATTERN_meta-imf = "^${LAYERDIR}/"
BBFILE_PRIORITY_meta-imf = "10"

LAYERDEPENDS_meta-imf = "core openembedded-layer networking-layer stm-myir-st"
LAYERSERIES_COMPAT_meta-imf = "kirkstone"
```

## yocto-bsp/build/conf/bblayers.conf
```bitbake
# LAYER_CONF_VERSION is increased each time build/conf/bblayers.conf
# changes incompatibly
LCONF_VERSION = "7"

BBPATH = "${TOPDIR}"
BBFILES ?= ""
OEROOT := "${@os.path.abspath(os.path.dirname(d.getVar('FILE')) + '/../..')}"

#--------------------------
# Layers var definition for buildsystem
#
OPENEMBEDDED = "${OPENEMBEDDED_NON_REMOVABLE}"
OPENEMBEDDED_NON_REMOVABLE = "${OEROOT}/layers/openembedded-core/meta"

#--------------------------
BASELAYERS ?= " \
    ${OEROOT}/layers/meta-openembedded/meta-oe \
    ${OEROOT}/layers/meta-openembedded/meta-python \
    ${OEROOT}/layers/meta-openembedded/meta-gnome \
    ${OEROOT}/layers/meta-openembedded/meta-initramfs \
    ${OEROOT}/layers/meta-openembedded/meta-multimedia \
    ${OEROOT}/layers/meta-openembedded/meta-networking \
    ${OEROOT}/layers/meta-openembedded/meta-webserver \
    ${OEROOT}/layers/meta-openembedded/meta-filesystems \
    ${OEROOT}/layers/meta-openembedded/meta-perl \
"

BSPLAYER ?= " \
    ${@'${OEROOT}/layers/meta-st/meta-st-stm32mp' if os.path.isfile('${OEROOT}/layers/meta-st/meta-st-stm32mp/conf/layer.conf') else ''} \
    ${@'${OEROOT}/layers/meta-st/meta-st-stm32mp-addons' if os.path.isfile('${OEROOT}/layers/meta-st/meta-st-stm32mp-addons/conf/layer.conf') else ''} \
    "

ADDONSLAYERS = ""
# Qt5
ADDONSLAYERS += "${@'${OEROOT}/layers/meta-qt5' if os.path.isfile('${OEROOT}/layers/meta-qt5/conf/layer.conf') else ''}"

# specific to framework
FRAMEWORKLAYERS = ""
FRAMEWORKLAYERS += "${@'${OEROOT}/layers/meta-st/meta-st-openstlinux' if os.path.isfile('${OEROOT}/layers/meta-st/meta-st-openstlinux/conf/layer.conf') else ''}"
FRAMEWORKLAYERS += "${@'${OEROOT}/layers/meta-myir-st' if os.path.isfile('${OEROOT}/layers/meta-myir-st/conf/layer.conf') else ''}"

# Custom project layer
FRAMEWORKLAYERS += "${@'${OEROOT}/../software/meta-imf' if os.path.isfile('${OEROOT}/../software/meta-imf/conf/layer.conf') else ''}"

BBLAYERS += " \
    ${BASELAYERS} \
    ${BSPLAYER} \
    ${ADDONSLAYERS} \
    ${FRAMEWORKLAYERS} \
    ${OPENEMBEDDED} \
    "
```
